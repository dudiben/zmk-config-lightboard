## config/board/shields/two_percent_milk/Kconfig.shield
```kconfig
# Copyright (c) 2022 The ZMK Contributors
# SPDX-License-Identifier: MIT

config SHIELD_KEYLIGHT
    def_bool $(shields_list_contains,keylight)
```
